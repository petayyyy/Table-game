#define NUM_LEDS 576
#include "FastLED.h"
#define PIN 6 // pin led
CRGB leds[NUM_LEDS];

String str = "";
int x1 = 0; int x2 = 0; int y1 = 0; int y2 = 0;
bool players = 0;

int pose[64][10] = {{ 0 , 1 , 2 , 24 , 25 , 26 , 48 , 49 , 50 , 0},
{ 3 , 4 , 5 , 27 , 28 , 29 , 51 , 52 , 53 , 0},
{ 6 , 7 , 8 , 30 , 31 , 32 , 54 , 55 , 56 , 0},
{ 9 , 10 , 11 , 33 , 34 , 35 , 57 , 58 , 59 , 0},
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{ 525 , 526 , 527 , 549 , 550 , 551 , 573 , 574 , 575 , 0}};


void led_move(int c[10]){
  for(int i = 0; i < 9; i++) {
      leds[c[i]] = CRGB::White; 
  }
  FastLED.show(); delay(30); 
}
void led_xp(int c[10]){
  if (c[-1] == 2){
    for(int i = 0; i < 9; i++) {
      leds[c[i]] = CRGB::Green; 
  }
  }
  else if (c[-1] == 3){
    for(int i = 0; i < 9; i++) {
      if (i % 3 == 0){
        leds[c[i]] = CRGB::Red;
      }
  }
  }
  else if (c[-1] == 4){
    for(int i = 0; i < 9; i++) {
      if (i % 3 == 1){
        leds[c[i]] = CRGB::Red;
      }
  }
  }
  else if (c[-1] == 5){
    for(int i = 0; i < 9; i++) {
      if (i % 3 == 2){
        leds[c[i]] = CRGB::Red;
      }
  }
  }
  FastLED.show(); delay(30); 
}
void start(){
  for(int i = 0; i < 24; i++) {
      if (pose[i][-1] == 2){
        led_xp(pose[i],pose[i][-1]);
        } 
      }
}

void setup() {
  Serial.begin(9600);
  FastLED.addLeds<WS2811, PIN, GRB>(leds, NUM_LEDS).setCorrection( TypicalLEDStrip );
  FastLED.setBrightness(50);
  }

void loop() {
  if (Serial.available() > 0) {
    String n = Serial.readString();
    Serial.println(n);
    
    if (n[0] == '1'){
       Serial.println("New players");
       Serial.println(players);
       players = 1;
    }
    else if (n[0] == '2'){
      Serial.println("Led");
      str = n[2];
      x2 = str.toFloat();
      str = n[4];
      y2 = str.toFloat();
      led_move(pose[24*y2+x2])
    }
    else if (n[0] == '3'){
      Serial.println("Move");
      str = n[2];
      x1 = str.toFloat();
      str = n[4];
      y1 = str.toFloat();
      str = n[6];
      x2 = str.toFloat();
      str = n[8];
      y2 = str.toFloat();
      moveto(x1,x2,y1,y2);    
    }
    else if (n[0] == '4'){
       Serial.println("Damage");
       str = n[2];
       x1 = str.toFloat();
       str = n[4];
       y1 = str.toFloat();
       led_xp(pose[24*y1+x1])
    }
    Serial.println();}
}
